## Kconfig
```kconfig
source "../modules/drivers/gps/Kconfig"
source "../modules/drivers/hwmon/Kconfig"
source "../modules/drivers/modem_control/Kconfig"
source "../modules/drivers/misc/Kconfig"
source "../modules/drivers/input/Kconfig"
source "../modules/drivers/leds/Kconfig"
source "../modules/drivers/power/Kconfig"
source "../modules/drivers/staging/Kconfig"
source "../modules/drivers/pinctrl/Kconfig"
source "../modules/drivers/platform/x86/Kconfig"
source "../modules/drivers/switch/Kconfig"
```

## hwmon/Kconfig
```kconfig
config MID_PWM
	tristate "MID PWM driver for Intel Medfield platform"
        depends on INTEL_SCU_IPC
        help
	  Say Y here to enable MID PWM driver on Intel Medfield Platform.
	  This driver provides an interface to control the duty cycle of
	  an output signal. For more information, please refer to the driver
	  source code.

config SENSORS_L3G4200D_POLL
	tristate "Polling based STMicroeletronics L3G4200D three-axis angular rate sensor"
	depends on I2C && INPUT
	default y
	help
	   A polling based L3G4200D gyroscope sensor driver. Support retrieving
	   gyro data with specified polling intervals in milliseconds. Suitable
	   for low precision but easy use requirements such as for Android integration.
           Say Yes here to enable it.

	   This driver can also be built as a module. If so, the module
	   will be called l3g4200d_poll.

config SENSORS_LIS3DH_ACC
	tristate "ST Accel Sensor Driver"
	depends on I2C
	select INPUT_POLLDEV
	default y
	help
	  Say Yes here to enable the ST LIS3DH accelerometer support
	  conected through I2C.

	  ST LIS3DH is a 3-axis linear accelerometer with digital output.

          This driver can also be built as a module. If so, the module
          will be called lis3dh_acc.

config SENSORS_LPS331AP
	tristate "LPS331AP pressure sensor Driver"
	depends on I2C && INPUT
	default y
	help
	   Say yes here to enable LPS331AP pressure sensor driver

	   Pressure sensor LPS331AP from STMicroelectronics
	   please search on
	   http://www.st.com/ for more details.

	   This driver can also be built as a module. If so, the module
	   will be called lps331ap.

config SENSORS_LSM303_MAG
	tristate "ST LSM303DLHC Magnetometer Driver"
	depends on I2C
	select INPUT_POLLDEV
	default y
	help
	  Say Yes here to enable the ST LSM303DLHC Magnetometer Driver

	  This driver will enable ST LSM303DLHC Magnetometer device.
	  LSM303DLHC Magnetometer device is ultra compact high performance
	  e-compass.

	  This driver can also be built as a module. If so, the module
	  will be called lsm303dlhc_compass.
```

## input/touchscreen/Kconfig
```kconfig
config TOUCHSCREEN_ATMEL_MXT224
	tristate "ATMEL mXT224 touchscreen"
	depends on I2C
	default n
	help
		Say Y here if you have a mXT224 touchscreen
		If unsure, say N.

config TOUCHSCREEN_ATMEL_MXT1664S
	tristate "Atmel mXT 1664S I2C Touchscreen"
	depends on I2C
	help
	  Say Y here if you have Atmel mXT series I2C touchscreen,
	  ATMXT1664S, connected to your system.

	  If unsure, say N.

	  To compile this driver as a module, choose M here: the
	  module will be called atmel_mxt_1664S.
```

## misc/Kconfig
```kconfig
config SCU_LOGGING
	tristate "Intel SCU fabric debug driver"
	default n
	---help---
	 Driver that enable for debugging Intel SCU firmware fabric related error.
```

## modem_control_HW736/Kconfig
```kconfig
#
# Modem Control Driver.
# Perform power on/reset/power off on IMC modems
#

config MDM_CTRL_HW736
	tristate "Modem control driver HW736"
	default y
	---help---
	  The modem control driver for HW736 modems. This driver will perform any
	  power request on IMC modems. It will create /dev/mdm_ctrl char device
	  by default.
	  Verified for XMM6260, XMM7160, XMM6360 and XMM 6263 modems.

config MDM_CTRL_DEV_NAME
	string "Boot driver device name"
	depends on MDM_CTRL_HW736
	default "mdm_ctrl"
	---help---
	  Sets the name for the modem control driver device.

	  If unsure, use the default value.

config ENABLE_MODULE_HW736 
	bool "enable module HW736"
	default y
	---help---
    enable modem module HW736
	
config ENABLE_MODULE_H350
	bool "enable module H350"
	default y
	---help---
    enable modem module H350
```

## platform/x86/Kconfig
```kconfig
#
# X86 Platform Specific Drivers
#
config GPIO_INTEL_MSIC
	bool "Intel MSIC GPIO support"
	depends on INTEL_SCU_IPC && GPIOLIB
	---help---
	  MSIC provides a GPIO subsystem containing several input
	  output pins.
	  Say Y here to support GPIO via the SCU IPC interface
	  on Intel MID platforms.

config INTEL_MID_OSNIB_ILB
        tristate "cmos osnib driver for Intel BYT platforms"
        default n
        ---help---
			This driver adds OSNIB support using CMOS.
			OSNIB is used to share flags between firmware and kernel.
			This is only valid when no SCU is present.

			If unsure, say N.

config INTEL_MID_OSIP
	tristate "osip driver for Intel MID platforms"
	depends on INTEL_SCU_IPC
	default y
	help
	  This driver modifies the osip header when rebooting,
	  so that one can type 'reboot bootloader' to fall back
	  in kboot mode.

	  If unsure, say N.

config INTEL_MID_OSIP_DEBUG_FS
	tristate "osip driver debug fs"
	depends on INTEL_MID_OSIP && DEBUG_FS
	default y
	help
	  This driver adds debugfs interface.
	  The main feature of that interface is to be able to modify the kernel
	  cmdline directly in the OSIP.
	  This has to be disabled if we have secure boot enabled by default.

	  If unsure, say N.
```

## pwm/Kconfig
```kconfig
if PWM

config PWM_BAYTRAIL
	tristate "Intel Baytrail SoC PWM support"

	help
	  Generic PWM framework driver for Intel Baytrail SoC.

	  To compile this driver as a module, choose M here: the module
	  will be called pwm-byt.
endif
```
